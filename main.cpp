#include <Arduino.h>
#include <RF24.h>
#include <Wire.h>
#include <Adafruit_NeoPixel.h>
#include "nRF24L01.h"
#include <SPI.h>
#include <Adafruit_GFX.h>
#include <Adafruit_SSD1306.h>

#define indicator 8
#define error_led 7
#define small_button 0
#define up_button 1
#define down_button 12

int ADXL345 = 0x53;
float X, Y, Z, oX, oY, oZ = 0;
int mX, mY, mZ = 0;
float data[3] = {0, 0, 0};

const byte address[6] = "00001";

int menu_ctr = 0;
int menuset = 0;
bool in_menu = 0;

//led settings
bool pixel = true;
bool err_led = true;

Adafruit_NeoPixel strip = Adafruit_NeoPixel(1, indicator, NEO_RGB + NEO_KHZ800);
RF24 radio(6, 9);
Adafruit_SSD1306 display = Adafruit_SSD1306(128, 64, &Wire);

bool buttonstate_sel, buttonstate_up, buttonstate_down, laststate_sel, laststate_up, lastate_down = true; 

const unsigned char tg_soft [] PROGMEM = {
	0x00, 0x00, 0x00, 0x00, 0x00, 0x00, 0x00, 0x00, 0x00, 0x00, 0x00, 0x00, 0x00, 0x00, 0x00, 0x00, 
	0x00, 0x00, 0x00, 0x00, 0x00, 0x00, 0x00, 0x00, 0x00, 0x00, 0x00, 0x00, 0x00, 0x00, 0x00, 0x00, 
	0x00, 0x00, 0x00, 0x00, 0x00, 0x00, 0x00, 0x00, 0x00, 0x00, 0x00, 0x00, 0x00, 0x00, 0x00, 0x00, 
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	0x00, 0x00, 0x00, 0x00, 0x00, 0x00, 0x00, 0x00, 0x00, 0x00, 0x00, 0x00, 0x00, 0x00, 0x00, 0x00
};

void colorWipe(uint32_t c, uint8_t wait)
{
  for(uint16_t i = 0; i < strip.numPixels(); i++)
  {
    strip.setPixelColor(i, c);
    strip.show();
    delay(wait);
  } 
}

void acc_mes()
{
  Wire.beginTransmission(ADXL345);
  Wire.write(0x32);
  Wire.endTransmission(false);
  Wire.requestFrom(ADXL345, 6, true);
  X = (Wire.read() | Wire.read() << 8);
  X = X / 256;
  Y = (Wire.read() | Wire.read() << 8);
  Y = Y / 256;
  Z = (Wire.read() | Wire.read() << 8);
  Z = Z / 256;
  mX = X*1000;
  mY = Y*1000;
  mZ = Z*1000;
}

void send_data()
{
  if(radio.write(&data, sizeof(data)) == false)
  {
    delay(100);
  }
}

void menu()
{
  if(menuset == 0)
  {
    display.clearDisplay();
    display.setTextSize(1);
    display.setTextColor(SSD1306_WHITE);
    display.setCursor(10, 10);
    display.print("    H.A.N.D");
    display.setCursor(10, 20);
    display.print("Acceleration (mG):");
    display.setCursor(20, 32);
    display.print("X: ");
    display.setCursor(35, 32);
    display.print(mX);
    display.setCursor(20, 42);
    display.print("Y: ");
    display.setCursor(35, 42);
    display.print(mY);
    display.setCursor(20, 52);
    display.print("Z: ");
    display.setCursor(35, 52);
    display.print(mZ);
    display.display();
    colorWipe(strip.Color(10, 100, 100), 0);
  }
  else if(menuset == 1)
  {
    display.setTextSize(1);
    display.setTextColor(SSD1306_WHITE);
    display.clearDisplay();
    display.setCursor(10, 10);
    display.print("    H.A.N.D");
    if(menu_ctr == 0 && in_menu == 0)
    {
      display.setCursor(10, 20);
      display.print(">Acceleration<");
      display.setCursor(10,30);
      display.print(" Led Settings");
      display.setCursor(10,40);
      display.print(" System Data");
      display.setCursor(10,50);
      display.print(" About");
      display.display();
    }
    if(menu_ctr == 1 && in_menu == 0)
    {
      display.setCursor(10, 20);
      display.print(" Acceleration");
      display.setCursor(10,30);
      display.print(">Led Settings<");
      display.setCursor(10,40);
      display.print(" System Data");
      display.setCursor(10,50);
      display.print(" About");
      display.display();
    }
    if(menu_ctr == 2 && in_menu == 0)
    {
      display.setCursor(10, 20);
      display.print(" Acceleration");
      display.setCursor(10,30);
      display.print(" Led Settings");
      display.setCursor(10,40);
      display.print(">System Data <");
      display.setCursor(10,50);
      display.print(" About");
      display.display();
    }
    if(menu_ctr == 3 && in_menu == 0)
    {
      display.setCursor(10, 20);
      display.print(" Acceleration");
      display.setCursor(10,30);
      display.print(" Led Settings");
      display.setCursor(10,40);
      display.print(" System Data");
      display.setCursor(10,50);
      display.print(">About      <");
      display.display();
    }

    if(menu_ctr == 1 && in_menu == 1)
    {
      display.setCursor(10, 20);
      display.print("LED SETTINGS");
      display.setCursor(10,30);
      if(pixel == 1) display.print("RGB DIODE: TRUE");
      else display.print("RGB DIODE: FALSE");
      display.setCursor(10,40);
      if(err_led == 1) display.print("RED LED:   TRUE");
      else display.print("RED LED:   FALSE");
      display.setCursor(10,50);
      display.print("Change by UP/DOWN");
      display.display();
    }
    if(menu_ctr == 2 && in_menu == 1)
    {
      display.setCursor(0,20);
      display.print("Adafruit Flora (32u4)");
      display.setCursor(0,30);
      display.print("ADXL345 accelerometer");
      display.setCursor(0,40);
      display.print("SSD1306 OLED display");
      display.setCursor(0,50);
      display.print("nRF24L01 transceiver");
      display.display();
    }
    if(menu_ctr == 3 && in_menu == 1)
    {
      display.setCursor(0,20);
      display.print("Hand-worn Acclrmtr Nabbing Dvc. Crt by Tomasz Gondek. MIT Lic. github.com/tomaszgondek/H_A_N_D");
      display.display();
    }
  }
}

void menu_controller()
{
  buttonstate_sel = digitalRead(small_button);
  buttonstate_down = digitalRead(down_button);
  buttonstate_up = digitalRead(up_button);
  if(buttonstate_sel == LOW && buttonstate_sel != laststate_sel)
  {
    if(menuset == 0)
    {
      menuset = 1;
    }
    else if(menuset == 1)
    {

      if(menu_ctr == 0)
      {
        menuset = 0;
      }
      else
      {
        in_menu = !in_menu;
      }
    }
  }
  if(buttonstate_down == LOW && buttonstate_down != lastate_down && menuset == 1)
  {
    if(in_menu == 0)
    {
      menu_ctr -= 1;
      if(menu_ctr < 0)
      {
        menu_ctr = 0;
      }
    }
    if(in_menu == 1 && menu_ctr == 1)
    {
      err_led = !err_led;
    }
  }
  if(buttonstate_up == LOW && buttonstate_up != laststate_up && menuset == 1)
  {
    if(in_menu == 0)
    {
      menu_ctr += 1;
      if(menu_ctr > 3)
      {
        menu_ctr = 3;
      }
    }
    if(in_menu == 1 && menu_ctr == 1)
    {
      pixel = !pixel;
    }
  }
  laststate_sel = buttonstate_sel;
  lastate_down = buttonstate_down;
  laststate_up = buttonstate_up;
  delay(50);
  menu();
}

void setup() 
{
  display.begin(SSD1306_SWITCHCAPVCC, 0x3C);
  display.display();
  delay(750);
  display.clearDisplay();
  display.setCursor(0,0);
  display.drawBitmap(0, 0, tg_soft, 128, 64, WHITE);
  display.display();
  delay(750);
  display.clearDisplay();
  radio.begin();
  radio.openWritingPipe(address);
  radio.setPALevel(RF24_PA_MIN);
  radio.stopListening();
  pinMode(error_led, OUTPUT);
  pinMode(up_button, INPUT_PULLUP);
  pinMode(down_button, INPUT_PULLUP);
  pinMode(small_button, INPUT_PULLUP);
  strip.begin();
  strip.setBrightness(25);
  strip.show();
  Wire.begin();
  Wire.beginTransmission(ADXL345);
  Wire.write(0x2D);
  Wire.write(8);
  Wire.endTransmission();
}

void loop() 
{ 
  acc_mes();
  data[1] = X - oX;
  data[2] = Y - oY;
  data[3] = Z - oZ;
  send_data();
  menu_controller();
}
